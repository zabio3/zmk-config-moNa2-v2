## config/boards/shields/moNa2/Kconfig.defconfig
```kconfig
if SHIELD_MONA2_MAX_R

config ZMK_KEYBOARD_NAME
    default "moNa2_max_R"

config ZMK_SPLIT
    default y

config ZMK_SPLIT_ROLE_CENTRAL
    default y

endif

if SHIELD_MONA2_MAX_L

config ZMK_KEYBOARD_NAME
    default "moNa2_max_L"

config ZMK_SPLIT
    default y

endif
```

## config/boards/shields/moNa2/Kconfig.shield
```kconfig
config SHIELD_MONA2_MAX_R
    def_bool $(shields_list_contains,moNa2_max_R)

config SHIELD_MONA2_MAX_L
    def_bool $(shields_list_contains,moNa2_max_L)
```
